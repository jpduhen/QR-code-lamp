## main/Kconfig.projbuild
```kconfig
menu "QR museum lamp (JC3248W535)"

config LAMP_FIRMWARE_VERSION
    string "Visible firmware version"
    default "v0.5.0"
    help
        Small version label shown in the lower-right corner of the QR scan
        screen. This is intentionally independent from the ESP-IDF Git-derived
        app version, which can become dirty when local SD/media files are
        changed.

config LAMP_QR_RX_GPIO
    int "GPIO connected to the scanner TX"
    default 17
    help
        The scanner must use 3.3 V TTL UART and send an Enter/newline suffix.
        GPIO17 is pin 3 on either P3 or P4, the JC3248W535 Extended IO
        connector. Do not connect
        a 5 V TTL output directly to the ESP32-S3.

config LAMP_QR_TX_GPIO
    int "GPIO connected to the scanner RX"
    default 18
    help
        GPIO18 is pin 4 on either P3 or P4, the JC3248W535 Extended IO
        connector. This is used to query or configure the scanner.

config LAMP_QR_BAUD
    int "Scanner UART speed"
    default 9600
    range 1200 115200

config LAMP_AUDIO_VOLUME
    int "Audio volume (percent)"
    default 70
    range 1 100
    help
        Digital gain applied before 16-bit I2S audio. Start around 60-70 percent.

config LAMP_VIDEO_FPS
    int "MJPEG frame rate"
    default 10
    range 1 30
    help
        Frame rate used by raw MJPEG media. Ten frames per second is the
        preferred setting for the JPEGDEC player at 480x272.

config LAMP_MJPEG_USE_NEW_JPEG
    bool "Use esp_new_jpeg for MJPEG playback"
    default y
    help
        Decode MJPEG frames with Espressif's esp_new_jpeg decoder. This decoder
        has ESP32-S3 SIMD optimisations and targets RGB565 output directly.
        If a frame cannot be decoded, playback falls back to the previous
        JPEGDEC path for that frame.

config LAMP_EXPERIMENTAL_VIDEO_POC
    bool "Boot direct MJPEG-player performance test"
    default n
    help
        Experimental only.  Starts a direct AXS15231B/QSPI video player before
        LVGL and measures its actual frame rate over USB serial.  QR scanning,
        touch controls, audio and the normal museum UI are intentionally not
        started in this mode.

config LAMP_EXPERIMENTAL_VIDEO_PATH
    string "MJPEG path for direct-player test"
    depends on LAMP_EXPERIMENTAL_VIDEO_POC
    default "/sdcard/videos/18000.mjpeg"
    help
        Absolute SD-card path to a baseline JPEG 480x272 MJPEG file.

config LAMP_EXPERIMENTAL_VIDEO_HALF_SCALE
    bool "Decode the direct-player test at 240x136"
    depends on LAMP_EXPERIMENTAL_VIDEO_POC
    default y
    help
        Decodes every 480x272 JPEG at half resolution, then enlarges it to the
        480x272 display viewport. This measures the speed/quality trade-off
        without requiring a separately converted test file.

endmenu
```

## sdkconfig.defaults
```kconfig
CONFIG_IDF_TARGET="esp32s3"
CONFIG_ESPTOOLPY_FLASHMODE_QIO=y
CONFIG_ESPTOOLPY_FLASHFREQ_80M=y
CONFIG_ESPTOOLPY_FLASHSIZE_16MB=y
CONFIG_SPIRAM=y
CONFIG_SPIRAM_MODE_OCT=y
CONFIG_SPIRAM_TYPE_AUTO=y
CONFIG_SPIRAM_SPEED_80M=y
CONFIG_LV_COLOR_16_SWAP=y
CONFIG_LV_FONT_MONTSERRAT_20=y
CONFIG_LV_FONT_MONTSERRAT_32=y
CONFIG_SPIRAM_BOOT_INIT=y
CONFIG_SPIRAM_CLK_IO=30
CONFIG_SPIRAM_CS_IO=26
CONFIG_COMPILER_OPTIMIZATION_PERF=y
CONFIG_FREERTOS_HZ=1000
CONFIG_LOG_DEFAULT_LEVEL_INFO=y
CONFIG_LAMP_FIRMWARE_VERSION="v0.5.0"
CONFIG_LAMP_VIDEO_FPS=10
CONFIG_TINYUSB_MSC_ENABLED=y
```
